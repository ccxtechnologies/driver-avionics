## denx-patch/driver/drivers/net/arinc429/Kconfig
```kconfig
menu "ARINC429 Device Drivers"

config ARINC429_VARINC429
	tristate "Virtual Local ARINC429 Interface (varinc429)"
	---help---
	  Similar to the network loopback devices, varinc429 offers a
	  virtual local ARINC429 interface.

	  This driver can also be built as a module.  If so, the module
	  will be called varinc429.

config ARINC429_DEV
	tristate "Platform ARINC429 drivers with Netlink support"
	default y
	---help---
	  Enables the common framework for platform ARINC429 drivers with Netlink
	  support. This is the standard library for ARINC429 drivers.
	  If unsure, say Y.

if ARINC429_DEV

endif

config ARINC429_DEBUG_DEVICES
	bool "ARINC429 devices debugging messages"
	---help---
	  Say Y here if you want the ARINC429 device drivers to produce a bunch of
	  debug messages to the system log.  Select this if you are having
	  a problem with ARINC429 support and want to see more of what is going
	  on.

endmenu
```

## denx-patch/driver/net/arinc429/Kconfig
```kconfig
#
# ARINC429 network layer core configuration
#

menuconfig ARINC429
	depends on NET
	tristate "ARINC429 bus subsystem support"
	---help---
	  ARINC429 is a slow communication protocol used in avionics.
	  More information on the ARINC429 protocol family PF_ARINC429
	  is contained in <Documentation/networking/arinc429.txt>.

	  If you want ARINC429 support you should say Y here and also to
	  the specific driver for your controller(s) below.

if ARINC429

config ARINC429_RAW
	tristate "Raw ARINC429 Protocol"
	default y
	---help---
	  The raw ARINC429 protocol option offers access to the ARINC429
	  bus via the BSD socket API. You probably want to use the raw
	  socket in most cases where no higher level protocol is being
	  used. The raw socket has several filter options e.g. ID masking
	  / error frames. To receive/send raw ARINC429 messages, use AF_ARINC429
	  with protocol ARINC429_RAW.

source "drivers/net/arinc429/Kconfig"

endif
```
